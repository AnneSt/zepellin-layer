## conf/bblayers.conf.sample
```bitbake
# LAYER_CONF_VERSION is increased each time build/conf/bblayers.conf
# changes incompatibly
POKY_BBLAYERS_CONF_VERSION = "2"

BBPATH = "${TOPDIR}"
BBFILES ?= ""

REPOROOT = "##OEROOT##/.."

BBLAYERS ?= " \
  ${REPOROOT}/poky-sumo/meta \
  ${REPOROOT}/poky-sumo/meta-poky \
  ${REPOROOT}/poky-sumo/meta-openembedded/meta-oe \
  ${REPOROOT}/poky-sumo/meta-openembedded/meta-networking \
  ${REPOROOT}/poky-sumo/meta-openembedded/meta-multimedia \
  ${REPOROOT}/poky-sumo/meta-openembedded/meta-perl \
  ${REPOROOT}/poky-sumo/meta-openembedded/meta-python \
  ${REPOROOT}/poky-sumo/meta-qt5 \
  ${REPOROOT}/poky-sumo/meta-raspberrypi \
  ${REPOROOT}/poky-sumo/meta-security \
  ${REPOROOT}/rpi/meta-rpi \
  ${REPOROOT}/rpi/meta-zepellin \
"
```

## conf/layer.conf
```bitbake
# We have a conf and classes directory, append to BBPATH
BBPATH .= ":${LAYERDIR}"

# We have a recipes directory, add to BBFILES
BBFILES += "${LAYERDIR}/recipes*/*/*.bb ${LAYERDIR}/recipes*/*/*.bbappend ${LAYERDIR}/images/*.bb"

BBFILE_COLLECTIONS += "zepellin"
BBFILE_PATTERN_zepellin := "^${LAYERDIR}/"
BBFILE_PRIORITY_zepellin = "21"

LAYERSERIES_COMPAT_zepellin = "sumo"
```

## conf/local.conf.sample
```bitbake
# Local configuration for meta-rpi images
# Yocto Project 2.5 Poky distribution [sumo] branch
# This is a sysvinit system

LICENSE_FLAGS_WHITELIST = "commercial"

DISTRO_FEATURES = "ext2 pam opengl usbhost ${DISTRO_FEATURES_LIBC}"

#DISTRO_FEATURES_BACKFILL_CONSIDERED += "pulseaudio"

#PREFERRED_PROVIDER_jpeg = "libjpeg-turbo"
#PREFERRED_PROVIDER_jpeg-native = "libjpeg-turbo-native"

PREFERRED_PROVIDER_udev = "eudev"
VIRTUAL-RUNTIME_init_manager = "sysvinit"

MACHINE_FEATURES_remove = "apm"
# reicht aus um I2C und SPI zu aktivieren. ENABLE_* kann man sich sparen.
MACHINE_FEATURES += "pitft"

IMAGE_FSTYPES = "tar.xz"

PREFERRED_VERSION_linux-raspberrypi = "4.14.%"

# Choose the board you are building for
MACHINE = "raspberrypi3"

# Choices are Image or zImage if NOT using u-boot (no u-boot is the default)
# Choices are uImage or zImage if using u-boot, though if you choose zImage
# with u-boot you will also have to change the boot script boot command
KERNEL_IMAGETYPE = "zImage"
RPI_EXTRA_CONFIG="kernel=zImage"
DISBALE_SPLASH="1"
DISABLE_RPI_BOOT_LOGO="1"
VIDEO_CAMERA="1"
ENABLE_SPI_BUS="1"
ENABLE_I2C="1"
ENABLE_UART="1"

KERNEL_MODULE_AUTOLOAD += "i2c-dev"

DISTRO ?= "poky"

PACKAGE_CLASSES ?= "package_deb"

# i686 or x86_64
SDKMACHINE = "x86_64"

#EXTRA_IMAGE_FEATURES = "debug-tweaks"
INHERIT += "extrausers"
EXTRA_USERS_PARAMS = "usermod -P zepellin root; "

USER_CLASSES = "image-mklibs image-prelink"

PATCHRESOLVE = "noop"

RM_OLD_IMAGE = "1"

INHERIT += "rm_work"

CONF_VERSION = "1"
```
